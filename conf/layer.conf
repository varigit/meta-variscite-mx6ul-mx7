## conf/layer.conf
```bitbake
# We have a conf and classes directory, add to BBPATH
BBPATH .= ":${LAYERDIR}"

# We have a packages directory, add to BBFILES
BBFILES += "${LAYERDIR}/recipes-*/*/*.bb \
            ${LAYERDIR}/recipes-*/*/*.bbappend \
            ${LAYERDIR}/qt5-layer/*/*/*.bb \
            ${LAYERDIR}/qt5-layer/*/*/*.bbappend"

BBFILE_COLLECTIONS += "variscite-6ul"
BBFILE_PATTERN_variscite-6ul := "^${LAYERDIR}"
BBFILE_PRIORITY_variscite-6ul = "9"

#
```

## conf/machine/imx6ul-var-dart.conf
```bitbake
#
#@TYPE: Machine
#@NAME: Variscite i.MX6UL DART MX6
#@SOC: i.MX6UL
#@DESCRIPTION: Machine configuration for Variscite i.MX6UL DART MX6
#@MAINTAINER: Ron Donio <ron.d@variscite.com>
#

include conf/machine/include/imx-base.inc
include conf/machine/include/tune-cortexa7.inc
#include conf/machine/include/imx6ul-common.inc

SOC_FAMILY = "mx6:mx6ul"

DEFAULTTUNE_mx6ul ?= "cortexa7hf-neon"

SERIAL_CONSOLE = "115200 ttymxc0"

MACHINE_FEATURES += " pci bluetooth touchscreen wifi"

#
#
# UBIFS for Variscite NAND 0.5 GB
#
UBI_ROOT_FS_NAME = "[rootfs]"
UBI_VOLNAME  = "rootfs"
MKUBIFS_ARGS = " -m 2048 -e 124KiB -c 3965 "
UBINIZE_ARGS = " -m 2048 -p 128KiB -s 2048 -O 2048 "
#
#
# UBIFS for Variscite NAND 1.0 GB
#
#UBI_ROOT_FS_NAME = "[rootfs]"
#UBI_VOLNAME  = "rootfs"
#MKUBIFS_ARGS = " -m 2048 -e 124KiB -c 7855 "
#UBINIZE_ARGS = " -m 2048 -p 128KiB -s 2048 -O 2048 "
#
MACHINE_SOCARCH_SUFFIX_mx6ul = "-mx6ul"

XSERVER_DRIVER_mx6ul = "xf86-video-fbdev"

# mx6 GPU libraries
PREFERRED_PROVIDER_virtual/egl_mx6ul = "mesa"
PREFERRED_PROVIDER_virtual/libgles1_mx6ul = "mesa"
PREFERRED_PROVIDER_virtual/libgles2_mx6ul = "mesa"
PREFERRED_PROVIDER_virtual/libgl_mx6ul = "mesa"
PREFERRED_PROVIDER_virtual/libg2d_mx6ul = ""

MACHINE_SOCARCH_FILTER_mx6ul = "libfslcodec libfslparser gst-fsl-plugins"

# Variscite BSP default providers
#
PREFERRED_PROVIDER_virtual/kernel ?= "linux-variscite"
PREFERRED_PROVIDER_virtual/kernel_mx6 ?= "linux-variscite"
PREFERRED_PROVIDER_virtual/kernel_imx6ul-var-dart ?= "linux-variscite"
PREFERRED_VERSION_linux-imx_mx6 = "3.14.28"
KERNEL_DEVICETREE = "imx6ul-var-dart-emmc_wifi.dtb imx6ul-var-dart-sd_emmc.dtb imx6ul-var-dart-nand_wifi.dtb  imx6ul-var-dart-sd_nand.dtb"


UBOOT_CONFIG ??= "nand sd "
UBOOT_CONFIG[sd] = "mx6ul_var_dart_mmc_defconfig,sdcard"
UBOOT_CONFIG[nand] = "mx6ul_var_dart_nand_defconfig,ubifs"
#UBOOT_CONFIG[mfgtool] = "mx6ul_14x14_evk_config"
#
#
PREFERRED_PROVIDER_wpa-supplicant-cli = "wpa-supplicant-wl18xx"
PREFERRED_PROVIDER_wpa-supplicant-passphrase = "wpa-supplicant-wl18xx"
PREFERRED_PROVIDER_wpa-supplicant = "wpa-supplicant-wl18xx"
#
MACHINE_ESSENTIAL_EXTRA_RDEPENDS += " wlconf \
				      iw \
				      hostap-daemon-wl18xx \
				      libnl \
				      crda \
				      wl18xx-target-scripts \
                                      ti-compat-wireless-wl18xx \
                                      wpa-supplicant-wl18xx \
				      bluez5 \
                                      wl18xx-firmware \
				    "



IMAGE_FSTYPES ?= "tar.bz2 ext3 sdcard ubi"
```
